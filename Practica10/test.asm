LIST P=16F887
#INCLUDE <P16F887.INC>
	__CONFIG    _CONFIG1, _LVP_OFF & _FCMEN_ON & _IESO_OFF & _BOR_OFF & _CPD_OFF & _CP_OFF & _MCLRE_ON & _PWRTE_ON & _WDT_OFF & _INTRC_OSC_NOCLKOUT
	__CONFIG    _CONFIG2, _WRT_OFF & _BOR21V
	ORG     0x000
CounterC    EQU     0x21
CounterB   	EQU     0x22
CounterA    EQU     0x23
COUNTU 		EQU 	0x24
COUNTD 		EQU 	0x25
COUNTC 		EQU 	0x26
COUNTM 		EQU 	0x27
CountMSA   EQU     0x28
CountMSB   EQU     0x29
CountMSC   EQU     0x30
confi		BSF   STATUS,RP0	 
			MOVLW 0x00		 ;
			MOVWF TRISA
			MOVWF TRISB
			BSF   STATUS,RP1 ;
			CLRF  ANSEL 	 ;
			CLRF  ANSELH	 ; 
			BCF   STATUS,RP0;
			BCF	  STATUS,RP1;
			CLRF  PORTA	;
			CLRF  PORTB
			MOVLW D'0'
			MOVWF COUNTM
			MOVLW D'1'
			MOVWF COUNTC
			MOVLW D'2'
			MOVWF COUNTD
			MOVLW D'3'
			MOVWF COUNTU


INICIO      CALL RETRASOS
			INCF COUNTM,1
			INCF COUNTC,1
			INCF COUNTD,1
			INCF COUNTU,1
			MOVLW D'17'
			SUBWF COUNTM,1
			SUBWF COUNTC,1
			SUBWF COUNTD,1
			SUBWF COUNTU,1
			DECFSZ COUNTM,0
			GOTO RECUM
			MOVLW D'0'
			MOVWF COUNTM
A1			DECFSZ COUNTC,0
			GOTO RECUC
			MOVLW D'0'
			MOVWF COUNTC
B1			DECFSZ COUNTD,0
			GOTO RECUD
			MOVLW D'0'
			MOVWF COUNTD
C1			DECFSZ COUNTU,0
			GOTO RECUU
			MOVLW D'0'
			MOVWF COUNTU
			GOTO  INICIO

RECUM       MOVLW D'17'
			ADDWF COUNTM,1
			GOTO  A1

RECUC       MOVLW D'17'
			ADDWF COUNTC,1
			GOTO  B1

RECUD       MOVLW D'17'
			ADDWF COUNTD,1
			GOTO  C1

RECUU       MOVLW D'17'
			ADDWF COUNTU,1
			GOTO  INICIO
			
TABLAB      ADDWF PCL,F
			;      	ABCDEFG
			RETLW b'01101110'; H
			RETLW b'11111100'; O
			RETLW b'00011100'; L
			RETLW b'11101110'; A
			RETLW b'00000000'; 
			RETLW b'11001110'; P
			RETLW b'11101110'; A
			RETLW b'11001110'; P
			RETLW b'01100000'; I
			RETLW b'10011100'; C
			RETLW b'11111100'; O
			RETLW b'10110110'; S
			RETLW b'00000000'; 
			RETLW b'11011010'; 2
			RETLW b'11111100'; 0
			RETLW b'11011010'; 2
			RETLW b'11110010'; 3
			RETLW b'11101110'; A
			

		   
RETRASOS	MOVLW 	D'2'
			MOVWF	CounterC
c			MOVLW	D'10'
			MOVWF	CounterB
a			MOVLW	D'80'
			MOVWF	CounterA
loop	    DECFSZ	CounterA,1
			GOTO	muestra
			DECFSZ	CounterB,1
			GOTO	a 
			DECFSZ	CounterC,1
			GOTO	c
			RETURN


muestra     CALL  SHOW
			GOTO  loop

SHOW        MOVLW B'00001000'
		    MOVWF PORTA
			MOVFW COUNTU	
			CALL TABLAB
			MOVWF PORTB
			CALL  MS5
			MOVLW B'00000100'
		    MOVWF PORTA
			MOVFW COUNTD	
			CALL TABLAB 
			MOVWF PORTB
			CALL  MS5
			MOVLW B'00000010'
		    MOVWF PORTA
			MOVFW COUNTC	
			CALL TABLAB 
			MOVWF PORTB
			CALL  MS5
			MOVLW B'00000001'
		    MOVWF PORTA
			MOVFW COUNTM
			CALL TABLAB 
			MOVWF PORTB
			CALL  MS5			
		    RETURN

MS5			movlw	D'1'
			movwf	CountMSA
b2			movlw	D'10'
			movwf	CountMSB
a2			movlw	D'5'
			movwf	CountMSC
loop1		decfsz	CountMSC,1
			goto	loop1
			decfsz	CountMSB,1
			goto	a2
			decfsz	CountMSA,1
			goto	b2
			RETURN
			END