LIST P=16F887
#INCLUDE <P16F887.INC>
	__CONFIG    _CONFIG1, _LVP_OFF & _FCMEN_ON & _IESO_OFF & _BOR_OFF & _CPD_OFF & _CP_OFF & _MCLRE_ON & _PWRTE_ON & _WDT_OFF & _INTRC_OSC_NOCLKOUT
	__CONFIG    _CONFIG2, _WRT_OFF & _BOR21V

		ORG     0x000  
		NOP
configPort	BSF   STATUS,RP0
		MOVLW 0xFF       ;
		MOVWF TRISA      ;
		MOVWF TRISC      ;
		MOVWF TRISD		 ;
		MOVLW 0x00		 ;
		MOVWF TRISB		 ;
		MOVLW b'11111110'
		MOVWF TRISE		;
		BSF   STATUS,RP1 ;
	
		CLRF ANSEL 	 ;
		CLRF ANSELH	 ; 
		BCF STATUS,RP0;
		BCF	 STATUS,RP1;
		CLRF PORTA ;
		CLRF PORTB ;
		CLRF PORTC ;
		CLRF PORTD 
		CLRF PORTE

inicio  BTFSC  PORTD,0;
		GOTO xoradd		;
		GOTO andor

andor  	BTFSC  	PORTD,1;
		GOTO    or;
		GOTO    and;

xoradd  BTFSC  	PORTD,1;
		GOTO    add;
		GOTO    xor;

xor		MOVF	PORTA,W;
		XORWF	PORTC,W;
		MOVWF   PORTB
		BCF     STATUS,0
		MOVF 	STATUS,W
		MOVWF   PORTE
		GOTO 	inicio

and		MOVF	PORTA,W;
		ANDWF	PORTC,W;
		MOVWF   PORTB
		BCF     STATUS,0
		MOVF 	STATUS,W
		MOVWF   PORTE
		GOTO 	inicio

add		MOVF	PORTA,W;
		ADDWF	PORTC,W;
		MOVWF   PORTB
		MOVF 	STATUS,W
		MOVWF   PORTE
		GOTO 	inicio

or		MOVF	PORTA,W;
		IORWF	PORTC,W;
		MOVWF   PORTB
		BCF     STATUS,0
		MOVF 	STATUS,W
		MOVWF   PORTE
		GOTO 	inicio

		END