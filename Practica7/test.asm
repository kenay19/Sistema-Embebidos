LIST P=16F887
#INCLUDE <P16F887.INC>
	__CONFIG    _CONFIG1, _LVP_OFF & _FCMEN_ON & _IESO_OFF & _BOR_OFF & _CPD_OFF & _CP_OFF & _MCLRE_ON & _PWRTE_ON & _WDT_OFF & _INTRC_OSC_NOCLKOUT
	__CONFIG    _CONFIG2, _WRT_OFF & _BOR21V

confi		BSF   STATUS,RP0
			MOVLW b'00000011'       ;
			MOVWF TRISA		 ;
			MOVLW 0x00		 ;
			MOVWF TRISD
			BSF   STATUS,RP1 ;
			CLRF ANSEL 	 ;
			CLRF ANSELH	 ; 
			BCF STATUS,RP0;
			BCF	 STATUS,RP1;
			CLRF PORTD ;
			CLRF PORTA	;

INICIO  	BTFSS PORTA,1 ;
			GOTO  MOTOR0
			GOTO  MOTOR1

MOTOR0   	BTFSS PORTA,0;
		 	GOTO  MOTOR0DER
		 	GOTO  MOTOR0IZQ

MOTOR1   	BTFSS PORTA,0;
		 	GOTO  MOTOR1DER
		 	GOTO  MOTOR1IZQ

MOTOR0DER 	MOVLW B'00000001'
			MOVWF PORTD
			GOTO  INICIO


MOTOR0IZQ	MOVLW B'00000010'
			MOVWF PORTD
			GOTO  INICIO



MOTOR1DER 	MOVLW B'00000100'
			MOVWF PORTD
			GOTO  INICIO


MOTOR1IZQ	MOVLW B'00001000'
			MOVWF PORTD
			GOTO  INICIO
		
			END
